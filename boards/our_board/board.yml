## boards/our_board/board.yml
```yaml
board:
  name: our_board
  full_name: Our Board
  vendor: espressif
  socs:
  - name: esp32s3
```

## boards/our_new_board/Kconfig
```kconfig
# Copyright (c) 2024 Espressif Systems (Shanghai) Co., Ltd.
# SPDX-License-Identifier: Apache-2.0

config HEAP_MEM_POOL_ADD_SIZE_BOARD
	int
	default 4096 if BOARD_OUR_NEW_BOARD_ESP32S3_PROCPU

config BOARD_OUR_NEW_BOARD
    select BOARD_EARLY_INIT_HOOK
```

## boards/our_new_board/board.yml
```yaml
board:
  name: our_new_board
  full_name: Board from scratch 
  vendor: espressif
  socs:
  - name: esp32s3
```
